/* Copyright (c) 2013, The Linux Foundation. All rights reserved.
 *
 * This program is free software; you can redistribute it and/or modify
 * it under the terms of the GNU General Public License version 2 and
 * only version 2 as published by the Free Software Foundation.
 *
 * This program is distributed in the hope that it will be useful,
 * but WITHOUT ANY WARRANTY; without even the implied warranty of
 * MERCHANTABILITY or FITNESS FOR A PARTICULAR PURPOSE.  See the
 * GNU General Public License for more details.
 */

/*---------------------------------------------------------------------------
 * This file is autogenerated file using gcdb parser. Please do not edit it.
 * Update input XML file to add a new entry or update variable in this file
 * VERSION = "1.0"
 *---------------------------------------------------------------------------*/
&mdss_mdp {
	dsi_lead_fwvga_vid: qcom,zte-lead-hx8379a-fwvga-video {
		qcom,mdss-dsi-panel-name = "zteLEAD(HX8379c)CPT_480*854_4P5Inch";
		qcom,mdss-pan-physical-height-dimension = <99>;		
		qcom,mdss-pan-physical-width-dimension = <56>;		
		zte,lcd-proc-panel-name = "zteLEAD(HX8379c)_480*854_4P5Inch";
		qcom,cont-splash-enabled;
		qcom,mdss-dsi-panel-controller = <&mdss_dsi0>;
		qcom,mdss-dsi-panel-type = "dsi_video_mode";
		qcom,mdss-dsi-panel-destination = "display_1";
		qcom,mdss-dsi-panel-framerate = <60>;
		qcom,mdss-dsi-virtual-channel-id = <0>;
		qcom,mdss-dsi-stream = <0>;
		qcom,mdss-dsi-panel-width = <480>;
		qcom,mdss-dsi-panel-height = <854>;
		qcom,mdss-dsi-h-front-porch = <60>;
		qcom,mdss-dsi-h-back-porch = <60>;
		qcom,mdss-dsi-h-pulse-width = <42>;
		qcom,mdss-dsi-h-sync-skew = <0>;
		qcom,mdss-dsi-v-front-porch = <14>;
		qcom,mdss-dsi-v-pulse-width = <4>;
		qcom,mdss-dsi-v-back-porch = <6>;
		qcom,mdss-dsi-h-left-border = <0>;
		qcom,mdss-dsi-h-right-border = <0>;
		qcom,mdss-dsi-v-top-border = <0>;
		qcom,mdss-dsi-v-bottom-border = <0>;
		qcom,mdss-dsi-bpp = <24>;
		qcom,mdss-dsi-color-order = <0>;
		qcom,mdss-dsi-underflow-color = <0xff>;
		qcom,mdss-dsi-border-color = <0>;
		qcom,mdss-dsi-on-command = [39 01 00 00 00 00 04 B9 ff 83 79
39 01 00 00 00 00 15 b1 44 18 18 31 51 90 f0 ee d4 80 38 38 f8 02 20 00 00 80 30 00
39 01 00 00 00 00 0A b2 80 fe 09 0c 30 50 11 42 15
39 01 00 00 00 00 0E b4 01 28 00 54 00 54 17 5a 17 5a b0 00 ff
39 01 00 00 00 00 02 cc 02
39 01 00 00 00 00 1E d3 00 00 00 00 00 06 06 32 10 03 00 03 03 5f 03 5f 00 08 00 08 35 33 07 07 37 07 07 37 07
39 01 00 00 00 00 21 d5 18 18 19 19 18 18 20 21 24 25 18 18 18 18 00 01 04 05 02 03 06 07 18 18 18 18 18 18 18 18 18 18
39 01 00 00 00 00 21 d6 18 18 18 18 19 19 25 24 21 20 18 18 18 18 05 04 01 00 03 02 07 06 18 18 18 18 18 18 18 18 18 18
39 01 00 00 00 00 2b e0 00 03 07 12 12 21 2e 39 06 0f 12 1b 12 16 18 15 16 09 14 15 18 00 03 07 12 12 21 2e 39 06 0f 12 1b 12 16 18 15 16 09 14 15 18
39 01 00 00 00 00 03 b6 27 27
39 01 00 00 00 00 04 c9 1F 00 0a
05 01 00 00 78 00 02 11 00
39 01 00 00 00 00 0A BA 41 83 A8 4D B2 24 00 00 50
05 01 00 00 0a 00 02 29 00
39 01 00 00 05 00 02 51 00 
39 01 00 00 05 00 02 53 00 
39 01 00 00 05 00 02 55 00 
];
		qcom,mdss-dsi-off-command = [
					05 01 00 00 78 00 02 10 00];
		qcom,mdss-dsi-on-command-state = "dsi_lp_mode";
		qcom,mdss-dsi-off-command-state = "dsi_hs_mode";
		qcom,mdss-dsi-h-sync-pulse = <1>;
		//qcom,mdss-dsi-traffic-mode = "burst_mode";
		qcom,mdss-dsi-lane-map = "lane_map_3012";
		qcom,mdss-dsi-bllp-eof-power-mode;
		qcom,mdss-dsi-bllp-power-mode;
		qcom,mdss-dsi-lane-0-state;
		qcom,mdss-dsi-lane-1-state;
		/*add for cmd mode start 20140410*/
               qcom,mdss-dsi-te-pin-select = <1>;
               qcom,mdss-dsi-wr-mem-start = <0x2c>;
               qcom,mdss-dsi-te-dcs-command = <1>;
               qcom,mdss-dsi-te-check-enable;
               qcom,mdss-dsi-te-using-te-pin;
               /*add for cmd mode end 20140410*/
		qcom,mdss-dsi-panel-timings = [7b 1a 10 00 3c 40 14 1c 15 03 04 00];
		qcom,mdss-dsi-t-clk-post = <0x07>;
		qcom,mdss-dsi-t-clk-pre = <0x0d>;
		qcom,mdss-dsi-bl-min-level = <1>;
		qcom,mdss-dsi-bl-max-level = <180>;
		qcom,mdss-dsi-dma-trigger = "trigger_sw";
		qcom,mdss-dsi-mdp-trigger = "none";
		//qcom,mdss-dsi-bl-cmd-gpio =  <&msm_gpio 97 0>;
		qcom,mdss-dsi-bl-pmic-control-type = "bl_ctrl_dcs";
		qcom,mdss-dsi-reset-sequence = <1 20>, <0 20>, <1 20>;

	};
};
